## CMakeLists.txt
```
cmake_minimum_required(VERSION 3.20.0)

find_package(Zephyr REQUIRED HINTS $ENV{ZEPHYR_BASE})
project(broker)

# Disable thread-safe statics for C++
set(NO_THREADSAFE_STATICS $<TARGET_PROPERTY:compiler-cpp,no_threadsafe_statics>)
zephyr_compile_options($<$<COMPILE_LANGUAGE:CXX>:${NO_THREADSAFE_STATICS}>)

# Add all .c and .cpp sources
file(GLOB_RECURSE app_sources src/*.c src/*.cpp)

# Link them into the app
target_sources(app PRIVATE ${app_sources})

# Add include paths
target_include_directories(app PRIVATE
  ${CMAKE_CURRENT_SOURCE_DIR}/src
  ${CMAKE_CURRENT_SOURCE_DIR}/src/model
)

# Optional: include Zephyr network common
include(${ZEPHYR_BASE}/samples/net/common/common.cmake)
```

## prj.conf
```kconfig
# Wi-Fi Configuration
CONFIG_WIFI=y

# Network Configuration
CONFIG_NET_CONFIG_AUTO_INIT=n
CONFIG_NET_CONNECTION_MANAGER=y
CONFIG_NET_DHCPV4=y
CONFIG_NET_DHCPV4_SERVER=y
CONFIG_NET_IF_MAX_IPV4_COUNT=10
CONFIG_NET_IF_MAX_IPV6_COUNT=2
CONFIG_NET_IPV4=y
CONFIG_NET_L2_ETHERNET=y
CONFIG_NET_L2_WIFI_MGMT=y
CONFIG_NET_MGMT=y
CONFIG_NET_MGMT_EVENT=y
CONFIG_NET_MGMT_EVENT_INFO=y
CONFIG_NET_MGMT_EVENT_QUEUE_SIZE=10
CONFIG_NET_MGMT_EVENT_STACK_SIZE=4096
CONFIG_NET_PKT_RX_COUNT=16
CONFIG_NET_PKT_TX_COUNT=16
CONFIG_NET_SOCKETS_SERVICE_STACK_SIZE=4096
CONFIG_NET_TCP=y
CONFIG_NET_UDP=y
CONFIG_NETWORKING=y

# LOG Configuration
CONFIG_NET_LOG=y
CONFIG_NET_DHCPV4_SERVER_LOG_LEVEL_DBG=y
CONFIG_NET_SOCKETS=y
CONFIG_NET_IPV6_RA_RDNSS=y
CONFIG_NET_IF_UNICAST_IPV6_ADDR_COUNT=3
CONFIG_NET_IF_MCAST_IPV6_ADDR_COUNT=2
CONFIG_POSIX_API=y

CONFIG_NET_MAX_CONTEXTS=20
CONFIG_NET_MAX_CONN=100
CONFIG_NET_BUF_DATA_SIZE=1024
CONFIG_NET_BUF_RX_COUNT=16
CONFIG_NET_BUF_TX_COUNT=16


# Enable the MQTT Lib
CONFIG_MQTT_LIB=y
CONFIG_CBPRINTF_FP_SUPPORT=y


CONFIG_CPP=y
CONFIG_STD_CPP17=y
CONFIG_TENSORFLOW_LITE_MICRO=y
CONFIG_MAIN_STACK_SIZE=2048
CONFIG_REQUIRES_FLOAT_PRINTF=y
CONFIG_STACK_USAGE=y
CONFIG_SYS_HEAP_RUNTIME_STATS=y
CONFIG_THREAD_STACK_INFO=y
CONFIG_INIT_STACKS=y
```

## boards/esp32s3_devkitc_procpu.conf
```kconfig
CONFIG_WIFI_ESP32=y
CONFIG_ESP32_WIFI_STA_AUTO_DHCPV4=y
CONFIG_ESP32_WIFI_AP_STA_MODE=n
CONFIG_WIFI_NM=y
CONFIG_WIFI_NM_MAX_MANAGED_INTERFACES=2
```

## src/main.c
```c
#include <string.h>
#include <zephyr/kernel.h>
#include <zephyr/logging/log.h>
#include "broker.h"
#include "wifi.h"


int main(void) {

    setup_wifi();
    start_connection_monitor();  // Start the monitoring thread

    return 0;
}
```

## src/broker.c
```c
#include <zephyr/logging/log.h>
#include <zephyr/net/socket.h>
#include <zephyr/net/net_ip.h>
#include <zephyr/net/net_context.h>
#include <zephyr/net/net_pkt.h>
#include "broker.h"
#include "connect.h"
#include "publish.h"
#include "subscribe.h"
#include "client.h"


LOG_MODULE_REGISTER(BROKER);
struct k_thread conn_monitor_thread1, conn_monitor_thread2;
K_THREAD_STACK_DEFINE(conn_monitor_stack1, STACK_SIZE);
K_THREAD_STACK_DEFINE(conn_monitor_stack2, STACK_SIZE);


void mqtt_recv_callback(struct net_context *context, 
                        struct net_pkt *pkt, 
                        union net_ip_header *ip_hdr, 
                        union net_proto_header *proto_hdr, 
                        int status, 
                        void *user_data) {
                        
	uint32_t start_cycles = k_cycle_get_32();
                            
    if (!pkt || status < 0) {
        LOG_ERR("Connection closed or error: %d", status);
        
        if (context) {
            LOG_INF("Closing TCP connection");
            net_context_put(context);  // Close the TCP connection
        }
        return;
    }

    size_t len = net_pkt_remaining_data(pkt);
    if (len == 0) {
        LOG_ERR("Received empty packet");
        net_pkt_unref(pkt);
        return;
    }

    uint8_t buffer[BUFFER_SIZE];
    if (len > BUFFER_SIZE) {
        LOG_WRN("Packet too large, truncating to %d bytes", BUFFER_SIZE);
        len = BUFFER_SIZE;
    }

    if (net_pkt_read(pkt, buffer, len) < 0) {
        LOG_ERR("Failed to read packet data");
        net_pkt_unref(pkt);
        return;
    }

	// Extract client IP address
    struct sockaddr_in *client_addr = (struct sockaddr_in *)&context->remote;
    char client_ip[NET_IPV4_ADDR_LEN];

    if (client_addr->sin_family != AF_INET) {
        LOG_ERR("Not an IPv4 address!");
        return;
    }

    if (!net_addr_ntop(AF_INET, &client_addr->sin_addr, client_ip, sizeof(client_ip))) {
        LOG_ERR("Failed to extract client IP!");
        return;
    }
    
    
	switch (buffer[0] & 0xF0) { // extract 4-bit control
        case MQTT_CONNECT:
            LOG_INF("MQTT CONNECT received");
            handle_connect(context, buffer, len, client_ip);
            break;

        case MQTT_PUBLISH:
            LOG_INF("MQTT PUBLISH received");
            handle_publish(context, buffer, len);
            break;

        case MQTT_SUBSCRIBE:
            LOG_INF("MQTT SUBSCRIBE received");
            handle_subscribe(context, buffer, len);
            break;

        case MQTT_UNSUBSCRIBE:
            LOG_INF("MQTT MQTT_UNSUBSCRIBE received");
            handle_unsubscribe(context, buffer, len);
            break;
            
        case MQTT_PINGREQ:
            LOG_INF("MQTT PINGREQ received");
            handle_ping(context, buffer, len, client_ip);
            break;

        case MQTT_PUBREC:
            LOG_INF("MQTT MQTT_PUBREC received");
            handle_pubrec(context, buffer, len);
            break;

        case MQTT_PUBACK:        
        	LOG_INF("MQTT MQTT_PUBBACK received");
            handle_puback(context, buffer, len);
            break;
            
        case MQTT_PUBREL:
            LOG_INF("MQTT MQTT_PUBREL received");
            handle_pubrel(context, buffer, len);
            break;
        
        case MQTT_PUBCOMP:
            LOG_INF("MQTT MQTT_PUBCOMP received");
            handle_pubcomp(context, buffer, len);
            break;
            
        case MQTT_DISCONNECT:
            LOG_INF("MQTT MQTT_DISCONNECT received");
            handle_disconnect(context, buffer, len);
            break;
        
        default:
            LOG_WRN("Unexpected MQTT message received: 0x%02X", buffer[0]);
            break;
    }

	// Get CPU cycle count at end
    uint32_t end_cycles = k_cycle_get_32();
    // Convert cycles to time in microseconds (µs)
    float elapsed_us = (float)k_cyc_to_us_floor32(end_cycles - start_cycles);
    // Convert to milliseconds (ms) for readability
    float elapsed_ms = elapsed_us / 1000.0f;
    
    //printf("Total Processing Time Per Msg: %.2f ms (%.0f µs)\r\n", elapsed_ms, elapsed_us);
    printf("Total Processing Time Per Msg: %.2f ms (%.0f µs)\r\n", (double)elapsed_ms, (double)elapsed_us);


    net_pkt_unref(pkt);
}

void mqtt_client_handler(struct net_context *client_ctx,
                         struct sockaddr *client_addr,
                         socklen_t client_addr_len,
                         int status,
                         void *user_data) {
    if (status < 0) {
        LOG_ERR("Connection failed: %d\n", status);
        return;
    }
    
    struct sockaddr_in *addr = (struct sockaddr_in *)client_addr;
	LOG_INF("Client connected from %s:%d\n", inet_ntoa(addr->sin_addr), ntohs(addr->sin_port));

    int ret = net_context_recv(client_ctx, mqtt_recv_callback, K_NO_WAIT, NULL);
    
    if (ret < 0) {
        LOG_ERR("Failed to register receive callback: %d\n", ret);
    } else {
        LOG_INF("Waiting for MQTT messages...\n");
    }
}

void mqtt_broker_listen(void) {
    int ret;
   	struct sockaddr_in broker_addr;
   	struct net_context *mqtt_ctx; // Ensure this is declared

	memset(&broker_addr, 0, sizeof(broker_addr));

	broker_addr.sin_family = AF_INET;
	broker_addr.sin_port = htons(BROKER_PORT);
	broker_addr.sin_addr.s_addr = htonl(INADDR_ANY); // Listen on any available IP

    // Create a TCP socket
    ret = net_context_get(AF_INET, SOCK_STREAM, IPPROTO_TCP, &mqtt_ctx);
    if (ret < 0) {
        LOG_ERR("Failed to create network context: %d\n", ret);
        return;
    }

    // Bind the socket to the address
    ret = net_context_bind(mqtt_ctx, (struct sockaddr *)&broker_addr, sizeof(broker_addr));
    if (ret < 0) {
        LOG_ERR("Failed to bind socket: %d\n", ret);
        return;
    }

    // Start listening for incoming connections
    ret = net_context_listen(mqtt_ctx, 5);
    if (ret < 0) {
        LOG_ERR("Failed to listen on socket: %d\n", ret);
        return;
    }

    LOG_INF("MQTT Broker listening on port %d (all interfaces)\n", BROKER_PORT);

    // Set up an asynchronous accept callback
    ret = net_context_accept(mqtt_ctx, mqtt_client_handler, K_FOREVER, NULL);
    if (ret < 0) {
        LOG_ERR("Failed to accept connections: %d\n", ret);
    }

}

void start_connection_monitor() {
    LOG_INF("Starting connection monitor thread...");
    
    k_thread_create(
        &conn_monitor_thread1,
        conn_monitor_stack1,
        K_THREAD_STACK_SIZEOF(conn_monitor_stack1),
        check_client_connections,
        NULL, NULL, NULL,
        7, 0, K_NO_WAIT
    );
    
}
```

## src/broker.h
```c
#include <zephyr/net/socket.h>



#define BROKER_PORT 1883
#define BUFFER_SIZE 256  // Define a reasonable buffer size


#define MQTT_PROTOCOL_LEVEL_311 4
#define MQTT_PROTOCOL_LEVEL_5   5
// MQTT packet types
#define MQTT_CONNECT     0x10  // Client request to connect to Server
#define MQTT_CONNACK     0x20  // Connect acknowledgment
#define MQTT_PUBLISH     0x30  // Publish message
#define MQTT_PUBACK      0x40  // Publish acknowledgment (QoS 1)
#define MQTT_PUBREC      0x50  // Publish received (QoS 2 part 1)
#define MQTT_PUBREL      0x60  // Publish release (QoS 2 part 2)
#define MQTT_PUBCOMP     0x70  // Publish complete (QoS 2 part 3)
#define MQTT_SUBSCRIBE   0x80  // Subscribe request
#define MQTT_SUBACK      0x90  // Subscribe acknowledgment
#define MQTT_UNSUBSCRIBE 0xA0  // Unsubscribe request
#define MQTT_UNSUBACK    0xB0  // Unsubscribe acknowledgment
#define MQTT_PINGREQ     0xC0  // Ping request
#define MQTT_PINGRESP    0xD0  // Ping response
#define MQTT_DISCONNECT  0xE0  // Client is disconnecting
#define MQTT_AUTH        0xF0  // Authentication (MQTT v5.0)
#define MQTT_CONNACK_ACCEPTED 0x00  // Connection accepted response
#define MQTT_CONNACK_REFUSED 0x05  // Refused connection


#define STACK_SIZE 1024


// MQTT CONNECT message structure
struct mqtt_connect_packet {
    uint8_t fixed_header;
    uint8_t remaining_length;
    char protocol_name[4]; // "MQTT"
    uint8_t protocol_level;
    uint8_t connect_flags;
    uint16_t keep_alive;
    char client_id[128]; // client ID sent in CONNECT
};

void mqtt_client_handler(struct net_context *client_ctx,
                         struct sockaddr *client_addr,
                         socklen_t client_addr_len,
                         int status,
                         void *user_data);
void mqtt_broker_listen(void);
void start_connection_monitor();
```

## src/client.c
```c
#include <string.h>
#include <time.h>
#include <zephyr/random/random.h>
#include <zephyr/kernel.h>
#include <zephyr/logging/log.h>
#include "message.h"
#include "client.h"


LOG_MODULE_REGISTER(CLIENT);

struct mqtt_client_info clients[MAX_CLIENTS];


void generate_random_client_id(char *client_id, size_t min_length) {
    const char charset[] = "ABCDEFGHIJKLMNOPQRSTUVWXYZabcdefghijklmnopqrstuvwxyz0123456789";
    size_t charset_size = sizeof(charset) - 1;
    size_t length = (min_length < MAX_CLIENT_ID_LEN) ? min_length : MAX_CLIENT_ID_LEN;
    
    bool is_unique;
    do {
        is_unique = true;

        for (size_t i = 0; i < length; i++) {
            uint8_t rand_byte;
            sys_rand_get(&rand_byte, sizeof(rand_byte));  // Use Zephyr's random API
            client_id[i] = charset[rand_byte % charset_size];
        }
        client_id[length] = '\0'; // Null-terminate the string

        // Check for uniqueness in the clients buffer
        for (int i = 0; i < MAX_CLIENTS; i++) {
            if (clients[i].connected && strcmp(clients[i].client_id, client_id) == 0) {
                is_unique = false;
                break; // Duplicate found, regenerate
            }
        }

    } while (!is_unique); // Repeat until a unique ID is generated
}

struct mqtt_client_info* get_client_info(struct net_context *ctx) {
    for (int i = 0; i < MAX_CLIENTS; i++) {
        if (clients[i].connected && clients[i].ctx == ctx) {
            return &clients[i];
        }
    }
    return NULL;
}

void handle_unexpected_disconnect(struct mqtt_client_info *client) {
    client->connected = false;  // Mark as disconnected

    if (client->has_will) {
        LOG_INF("Publishing Will message: %s on topic: %s\n", client->will_message, client->will_topic);
        client->has_will = false;
        delivery_will_message(client->client_id, client->will_topic, client->will_message, strlen(client->will_message), client->will_qos, client->will_retain);
    }
}

void check_client_connections(void) {
    while (1) {
        uint32_t now = k_uptime_get_32();  // Current time in milliseconds

        for (int i = 0; i < MAX_CLIENTS; i++) {
            if (clients[i].connected) {
                int64_t elapsed_time = (int64_t)now - (int64_t)clients[i].last_seen;

                // Check if this client appears timed out.
                if (elapsed_time > (clients[i].keep_alive * 1500)) {  // 1.5 * Keep-Alive
                    // Before disconnecting, check if another active client on the same IP exists.
                    bool same_ip_active = false;
                    for (int j = 0; j < MAX_CLIENTS; j++) {
                        if (j == i) {
                            continue;
                        }
                        if (clients[j].connected && (strcmp(clients[j].ip_addr, clients[i].ip_addr) == 0)) {
                            int64_t other_elapsed = (int64_t)now - (int64_t)clients[j].last_seen;
                            // If any other client on the same IP has not timed out, consider that as active.
                            if (other_elapsed <= (clients[j].keep_alive * 1500)) {
                                same_ip_active = true;
                                break;
                            }
                        }
                    }
                    if (same_ip_active) {
                        //LOG_INF("Client %s (IP: %s) not disconnected due to another active connection on same IP", 
                        //        clients[i].client_id, clients[i].ip_addr);
                    } else {
                        LOG_WRN("Client %s disconnected due to Keep-Alive timeout!", clients[i].client_id);
                        handle_unexpected_disconnect(&clients[i]);
                    }
                }
            }
        }
        k_sleep(K_MSEC(CHECK_INTERVAL_MS));  // Sleep to avoid busy looping
    }
}

uint8_t track_reconnect(uint8_t client_index) {
    uint32_t now = k_uptime_get() / 1000;  // Convert to seconds

    if (clients[client_index].reconnect_window_start == 0) {
        // First reconnect event, start window
        clients[client_index].reconnect_window_start = now;
        clients[client_index].reconnect_count = 1;
    } else if ((now - clients[client_index].reconnect_window_start) <= TIME_WINDOW_SEC) {
        // Reconnect within the same time window
        clients[client_index].reconnect_count++;
    } else {
        // Window expired, reset
        clients[client_index].reconnect_window_start = now;
        clients[client_index].reconnect_count = 1;
    }

    LOG_INF("Client %s reconnect frequency: %d reconnects/%d sec\n",
            clients[client_index].client_id, clients[client_index].reconnect_count, TIME_WINDOW_SEC);

    return clients[client_index].reconnect_count;
}
```

## src/client.h
```c
#ifndef CLIENT_H
#define CLIENT_H


#include <zephyr/net/net_ip.h>
#include <zephyr/net/net_context.h>
#include "message.h"


#define MAX_CLIENTS 20
#define MAX_CLIENT_ID_LEN 23  // 23 bytes
#define MIN_CLIENT_ID_LEN 5  // 5 bytes
#define ADDR_LEN NET_IPV4_ADDR_LEN
#ifndef TIME_WINDOW_SEC
#define TIME_WINDOW_SEC 10
#endif
#define CHECK_INTERVAL_MS 5000  // Check every 5 seconds



struct mqtt_client_info {
    bool connected;  
    char client_id[MAX_CLIENT_ID_LEN];  
    uint16_t keep_alive;    
    bool clean_session;  // Store Clean Session flag
	char ip_addr[ADDR_LEN];
	struct net_context *ctx;

    // Last Will & Testament (LWT)  
    bool has_will;  // This field tracks if a client has a Will message
    char will_topic[MAX_TOPIC_LEN];  
    char will_message[MAX_MESSAGE_LEN];  
    uint8_t will_qos;
    bool will_retain;

    uint32_t last_seen;
    uint32_t reconnect_window_start;
    uint8_t reconnect_count;   
};

extern struct mqtt_client_info clients[MAX_CLIENTS];



struct mqtt_client_info* get_client_info(struct net_context *ctx);
void generate_random_client_id(char *client_id, size_t min_length);
void handle_unexpected_disconnect(struct mqtt_client_info *client);
void check_client_connections();
uint8_t track_reconnect(uint8_t client_index);


#endif // CLIENT_H
```

## src/connect.c
```c
#include <zephyr/kernel.h>
#include <zephyr/logging/log.h>
#include <zephyr/net/mqtt.h>
#include <zephyr/net/socket.h>
#include <zephyr/net/net_ip.h>
#include <zephyr/net/net_context.h>
#include "broker.h"
#include "message.h"
#include "client.h"
#include "connect.h"
#include "subscribe.h"
#include "features.h"
#include "model/main_functions.h"
#include <stdint.h>


LOG_MODULE_REGISTER(CONNECT);


int send_connack(struct net_context *ctx, uint8_t return_code) {
    uint8_t connack_packet[] = {MQTT_CONNACK, 0x02, 0x00, return_code};
    LOG_INF("MQTT CONNACK sent");
    return net_context_send(ctx, connack_packet, sizeof(connack_packet), NULL, K_NO_WAIT, NULL);
}

void send_pingresp(struct net_context *ctx) {
    uint8_t pingresp_packet[] = {MQTT_PINGRESP, 0x00};
    net_context_send(ctx, pingresp_packet, sizeof(pingresp_packet), NULL, K_NO_WAIT, NULL);
    LOG_INF("MQTT PINGRESP sent");
}

bool session_exists(const char *client_id) {
    for (int i = 0; i < MAX_CLIENTS; i++) {
        if (strcmp(clients[i].client_id, client_id) == 0) {
            return clients[i].connected;  // Return true if client is marked as connected
        }
    }
    return false;
}

void initialize_client_session(int index, struct net_context *ctx, const char *client_id, 
							uint16_t keep_alive, const char *ip_addr, bool clean_session) {
    clients[index].connected = true;
    clients[index].clean_session = clean_session;
    clients[index].keep_alive = keep_alive;
    clients[index].last_seen = k_uptime_get_32();
   	
   	// Handle context assignment properly
    if (clients[index].ctx) {
        net_context_unref(clients[index].ctx);  // Release the old context if it exists
    }
    clients[index].ctx = ctx ? ctx : NULL;

    strncpy(clients[index].client_id, client_id, sizeof(clients[index].client_id) - 1);
    clients[index].client_id[sizeof(clients[index].client_id) - 1] = '\0';

    strncpy(clients[index].ip_addr, ip_addr, sizeof(clients[index].ip_addr) - 1);
    clients[index].ip_addr[sizeof(clients[index].ip_addr) - 1] = '\0';

    LOG_INF("Initialized session for client: %s", client_id);
}

int handle_connect(struct net_context *ctx, uint8_t *buffer, ssize_t length, const char *ip_addr) {
    if (length < 14) {  // Minimum size for a valid CONNECT packet
        LOG_ERR("CONNECT packet too short");
        return send_connack(ctx, MQTT_CONNACK_REFUSED);
    }

    struct mqtt_connect_packet packet = {0};
    packet.fixed_header = buffer[0];

    if (packet.fixed_header != MQTT_CONNECT) {
        LOG_ERR("Not a CONNECT message");
        return send_connack(ctx, MQTT_CONNACK_REFUSED);
    }

    uint16_t protocol_name_length = (buffer[2] << 8) | buffer[3];
    if (protocol_name_length != 4 || length < 10) {
        LOG_ERR("Invalid protocol name length");
        return send_connack(ctx, MQTT_CONNACK_REFUSED);
    }

    memcpy(packet.protocol_name, &buffer[4], 4);
    packet.protocol_name[4] = '\0';

    if (strncmp(packet.protocol_name, "MQTT", 4) != 0) {
        LOG_ERR("Unsupported protocol name: %s", packet.protocol_name);
        return send_connack(ctx, MQTT_CONNACK_REFUSED);
    }

    packet.protocol_level = buffer[8];
    if (packet.protocol_level != MQTT_PROTOCOL_LEVEL_311 && packet.protocol_level != MQTT_PROTOCOL_LEVEL_5) {
        LOG_ERR("Unsupported protocol level: %d", packet.protocol_level);
        return send_connack(ctx, MQTT_CONNACK_REFUSED);
    }

    packet.connect_flags = buffer[9];
    packet.keep_alive = (buffer[10] << 8) | buffer[11];

    bool clean_session = (packet.connect_flags & 0x02) ? true : false; // Bit 1
    LOG_INF("Connect Flags: %02X, Keep Alive: %d, Clean Session: %d", packet.connect_flags, packet.keep_alive, clean_session);

    int index = 12;  // Start parsing from Client ID length

    // --- Parse Client ID ---
    uint16_t client_id_length = (buffer[index] << 8) | buffer[index + 1];
    index += 2;

    char client_id[MAX_CLIENT_ID_LEN + 1] = {0};

    if (client_id_length > 0 && (index + client_id_length) <= length) {
        size_t copy_length = (client_id_length < MAX_CLIENT_ID_LEN) ? client_id_length : MAX_CLIENT_ID_LEN;
        memcpy(client_id, &buffer[index], copy_length);
        client_id[copy_length] = '\0';
        index += client_id_length;
    } else {
        if (clean_session) {
            LOG_WRN("Generating random client ID");
            generate_random_client_id(client_id, MIN_CLIENT_ID_LEN);
        } else {
            LOG_ERR("Client ID missing and clean session is 0");
            return send_connack(ctx, MQTT_CONNACK_REFUSED);
        }
    }

    LOG_INF("Client ID: %s connected", client_id);

    // --- Restore Previous Session If Needed ---
    int client_index = -1;
    
    for (int i = 0; i < MAX_CLIENTS; i++) {
        if (clients[i].connected && strcmp(clients[i].client_id, client_id) == 0) {
            client_index = i;
            break;
        }
    }
    
    if (client_index != -1 && !clean_session) {		
		if (!session_exists(client_id)) {
			LOG_INF("No existing session found, initializing new session");
			initialize_client_session(client_index, ctx, client_id, packet.keep_alive, ip_addr, clean_session);
		} else {
			LOG_INF("Restoring session for client: %s", client_id);
			
			// Update context properly only if it has changed
			if (clients[client_index].ctx != ctx) {
				if (clients[client_index].ctx) {
					net_context_unref(clients[client_index].ctx);  // Release the old context if it exists
				}
				clients[client_index].ctx = ctx;
				LOG_INF("Updated client context for %s", client_id);
			}
			restore_pending_messages(ctx, client_id);
		}
	} else {
		for (int i = 0; i < MAX_CLIENTS; i++) {
			if (!clients[i].connected || (clean_session && strcmp(clients[i].client_id, client_id) == 0)) {
				if (clean_session) {
					LOG_INF("Cleaning session for client: %s", clients[i].client_id);
					clear_subscriber(clients[i].client_id);
        			clear_pending_messages(clients[client_index].client_id);

					uint32_t prev_reconnect_count = clients[i].reconnect_count;
					uint32_t prev_reconnect_window_start = clients[i].reconnect_window_start;
					memset(&clients[i], 0, sizeof(clients[i]));  // Clear other fields					
					// preserve reconnect frequency
					clients[i].reconnect_count = prev_reconnect_count;
					clients[i].reconnect_window_start = prev_reconnect_window_start;
				}
				initialize_client_session(i, ctx, client_id, packet.keep_alive, ip_addr, clean_session);
				client_index = i;
				break;
			}
		}
	}

    if (client_index == -1) {
        LOG_ERR("No available session slots");
        return send_connack(ctx, MQTT_CONNACK_REFUSED);
    }

    // --- Handle Will Message ---
    if (packet.connect_flags & 0x04) {  // Will Flag (bit 2)
        uint16_t will_topic_length = (buffer[index] << 8) | buffer[index + 1];
        index += 2;
        char will_topic[MAX_TOPIC_LEN + 1] = {0};
        memcpy(will_topic, &buffer[index], will_topic_length);
        will_topic[will_topic_length] = '\0';
        index += will_topic_length;

        uint16_t will_message_length = (buffer[index] << 8) | buffer[index + 1];
        index += 2;
        char will_message[MAX_MESSAGE_LEN + 1] = {0};
        memcpy(will_message, &buffer[index], will_message_length);
        will_message[will_message_length] = '\0';
        index += will_message_length;

        clients[client_index].has_will = true;
        strncpy(clients[client_index].will_topic, will_topic, sizeof(clients[client_index].will_topic) - 1);
        strncpy(clients[client_index].will_message, will_message, sizeof(clients[client_index].will_message) - 1);
        clients[client_index].will_qos = (packet.connect_flags & 0x18) >> 3;
        clients[client_index].will_retain = (packet.connect_flags & 0x20) >> 5;
		store_will_message(client_id, will_topic, will_message, clients[client_index].will_qos, clients[client_index].will_retain);
    }

    send_connack(ctx, MQTT_CONNACK_ACCEPTED);

    struct connect_features features = get_connect_features(buffer, length, client_index, client_id);
    
	LOG_WRN("CONNECT Features:"
        " Event Type: %d,"
        " Clean Session: %d,"
        " Will Flag: %d,"
        " Will QoS: %d,"
        " Will Retain: %d,"
        " Will Payload Size: %d,"
        " Keep Alive: %d,"
        " Reconnect Freq: %d,"
        " Pending Queue: %d,"
        " Retained Queue: %d,"
        " Subscription Count: %d,"
        " Resub Freq: %d,"
        " Republish Freq: %d\n",
        features.event_type,
        features.clean_session,
        features.will_flag,
        features.will_flag ? features.will_qos : -1,
        features.will_flag ? features.will_retain : -1,
        features.will_flag ? features.will_payload_size : -1,
        features.keep_alive,
        features.reconn_freq,
        features.pending_queue_status,
        features.retained_queue_status,
        features.subscription_count,
        -1,  // Resubscription Frequency
        -1   // Republish Frequency
	);

	
	int8_t input_data[13] = {
		(int8_t)features.event_type,
		(int8_t)features.clean_session,
		(int8_t)features.will_flag,
		features.will_flag ? (int8_t)features.will_qos : -1,
		features.will_flag ? (int8_t)features.will_retain : -1,
		features.will_flag ? (int8_t)features.will_payload_size : -1,
		(int8_t)features.keep_alive,
		(int8_t)features.reconn_freq,
		(int8_t)features.pending_queue_status,
		(int8_t)features.retained_queue_status,
		(int8_t)features.subscription_count,
		-1,  // Resubscription Frequency
		-1   // Republish Frequency
	};

	analyze_message(input_data);


	return 0;
}

void handle_ping(struct net_context *ctx, uint8_t *buffer, ssize_t length, const char *ip_addr) {
    if (ctx == NULL || buffer == NULL || length < 2 || ip_addr == NULL) {
        LOG_ERR("MQTT PINGREQ: Invalid parameters!");
        return;
    }

    // Ensure packet is a valid PINGREQ (0xC0, 0x00)
    if (buffer[0] != 0xC0 || buffer[1] != 0x00) {
        LOG_WRN("MQTT PINGREQ: Invalid packet received!");
        return;
    }

    int client_index = -1;

    // Identify the client based on the IP address
    for (int i = 0; i < MAX_CLIENTS; i++) {
        if (clients[i].ip_addr[0] != '\0' && strcmp(clients[i].ip_addr, ip_addr) == 0) {
            client_index = i;
            break;
        }
    }

    if (client_index == -1) {
        LOG_WRN("MQTT PINGREQ: Client with IP %s not found!", ip_addr);
        return;
    }

    // Update last_seen timestamp
    clients[client_index].last_seen = k_uptime_get_32();
    LOG_INF("MQTT PINGREQ: Client %s updated last_seen to %u", 
            clients[client_index].client_id, clients[client_index].last_seen);
    
    send_pingresp(ctx);
}

void handle_disconnect(struct net_context *ctx, uint8_t *buffer, ssize_t length) {
    if (length < 2) {  // MQTT DISCONNECT packet should be at least 2 bytes (Fixed Header)
        LOG_ERR("DISCONNECT packet too short");
        return;
    }

    struct mqtt_client_info *client = get_client_info(ctx);
    // Find the client session based on the context
    int client_index = -1;
    for (int i = 0; i < MAX_CLIENTS; i++) {
        if (clients[i].connected && clients[i].client_id == client->client_id) {
            client_index = i;
            break;
        }
    }

    if (client_index == -1) {
        LOG_WRN("Client not found for DISCONNECT");
        return;
    }

    LOG_INF("Client %s sent DISCONNECT", clients[client_index].client_id);

    // Since the client is disconnecting normally, remove the Will message
    if (clients[client_index].has_will) {
        LOG_INF("Removing Will message for client: %s", clients[client_index].client_id);
        clear_will_message(clients[client_index].client_id);
        clients[client_index].has_will = false;
    }

    // Handle session cleanup if Clean Session was set
    if (clients[client_index].clean_session) {
        LOG_INF("Cleaning session for client: %s", clients[client_index].client_id);
        clear_subscriber(clients[client_index].client_id);
        clear_pending_messages(clients[client_index].client_id);
        
		uint32_t prev_reconnect_count = clients[client_index].reconnect_count;
		uint32_t prev_reconnect_window_start = clients[client_index].reconnect_window_start;
        memset(&clients[client_index], 0, sizeof(clients[client_index]));  // Reset client session
		// preserve reconnect frequency
		clients[client_index].reconnect_count = prev_reconnect_count;
		clients[client_index].reconnect_window_start = prev_reconnect_window_start;   
    }
    
    net_context_put(ctx);
}
```

## src/connect.h
```c
#include <zephyr/net/net_ip.h>
#include <zephyr/net/net_context.h>



bool session_exists(const char *client_id);
void initialize_client_session(int index, struct net_context *ctx, const char *client_id, 
							uint16_t keep_alive, const char *ip_addr, bool clean_session);
int send_connack(struct net_context *ctx, uint8_t return_code);
void send_pingresp(struct net_context *ctx);
void handle_ping(struct net_context *ctx, uint8_t *buffer, ssize_t length, const char *ip_addr);
int handle_connect(struct net_context *ctx, uint8_t *buffer, ssize_t length, const char *ip_addr);
void handle_disconnect(struct net_context *ctx, uint8_t *buffer, ssize_t length);
```

## src/features.c
```c
#include "message.h"
#include "client.h"
#include <stdint.h>
#include <zephyr/types.h>  // Zephyr-specific types
#include "features.h"
#include "publish.h"
#include "subscribe.h"

static uint32_t max_pending_queue = MAX_PENDING_MESSAGES;
static uint32_t max_retained_queue = MAX_RETAINED_MESSAGES;
static uint32_t max_payload_size = MAX_PACKET_SIZE;
static uint32_t max_subscription_queue = MAX_PERSISTENT_SUBSCRIPTIONS;
static uint32_t max_reconnect_freq = MAX_RECONNECT_FREQ;
static uint32_t max_resubscription_freq = MAX_RESUBSCRIPTION_FREQ;
static uint32_t max_republish_freq = MAX_REPUBLISH_FREQ;


uint8_t categorize_ratio(uint32_t value, uint32_t *max_value) {
    float ratio = (float)value / *max_value;
    
    return (ratio <= LOW_RATIO) ? 0 : (ratio <= HIGH_RATIO) ? 1 : 2;
}

bool check_topic_wildcard(const char *topic) {
    return (topic && (strchr(topic, '#') || strchr(topic, '+')));
}

struct connect_features get_connect_features(uint8_t *buffer, size_t length, uint8_t client_index, uint8_t client_id) {
    struct connect_features features = {0};

    if (length < 14) {
        return features; // Invalid packet
    }

    features.event_type = 1;
    features.keep_alive = (buffer[10] << 8) | buffer[11];
    
    uint8_t reconnect_freq = track_reconnect(client_index);
    features.reconn_freq = categorize_ratio(reconnect_freq, &max_reconnect_freq);;
    features.clean_session = (buffer[9] & 0x02) ? true : false;
    features.pending_queue_status = categorize_ratio(get_pending_queue_status(client_id), &max_pending_queue);

    features.keep_alive = (features.keep_alive <= 30) ? 0 :
                          (features.keep_alive <= 90) ? 1 : 2;

	uint8_t subscriber_index = get_subscriber_index(client_id);
    features.subscription_count = categorize_ratio(get_subscription_count(subscriber_index), &max_subscription_queue);


    if (buffer[9] & 0x04) {  // Will Flag
        features.will_flag = true;
        features.will_qos = (buffer[9] & 0x18) >> 3;
        features.will_retain = (buffer[9] & 0x20) >> 5;

        int index = 12;
        uint16_t client_id_length = (buffer[index] << 8) | buffer[index + 1];
        index += 2 + client_id_length;

        uint16_t will_topic_length = (buffer[index] << 8) | buffer[index + 1];
        index += 2;
        char will_topic[MAX_TOPIC_LEN + 1] = {0};
        memcpy(will_topic, &buffer[index], will_topic_length);
        will_topic[will_topic_length] = '\0';

        if (will_topic_length > 0) {
            features.retained_queue_status = categorize_ratio(
                get_retained_queue_status(will_topic), &max_retained_queue);
        }

        features.will_topic_contain_wildcard = check_topic_wildcard(will_topic);
        index += will_topic_length;

        uint16_t payload_size = (buffer[index] << 8) | buffer[index + 1];
        features.will_payload_size = categorize_ratio(payload_size, &max_payload_size);
    }

    return features;
}

struct publish_features get_publish_features(uint8_t *buffer, size_t length, struct mqtt_client_info *client) {
    struct publish_features features = {0};

    if (length < 2) {
        return features;
    }

    features.event_type = 2;
    uint8_t fixed_header = buffer[0];
    features.qos = (fixed_header & 0x06) >> 1;
    features.retain = (fixed_header & 0x01);
    features.clean_session = client->clean_session;
    features.pending_queue_status = categorize_ratio(get_pending_queue_status(client->client_id), &max_pending_queue);

    size_t remaining_length;
    size_t rem_len_bytes = decode_remaining_length(&buffer[1], &remaining_length);

    int index = 1 + rem_len_bytes;
    uint16_t topic_length = (buffer[index] << 8) | buffer[index + 1];
    index += 2;

    if (topic_length > 0 && index + topic_length <= length) {
        char topic[MAX_TOPIC_LEN + 1] = {0};
        memcpy(topic, &buffer[index], topic_length);
        topic[topic_length] = '\0';
        features.topic_contain_wildcard = check_topic_wildcard(topic);
        index += topic_length;

        features.retained_queue_status = categorize_ratio(get_retained_queue_status(topic), &max_retained_queue);
		features.republish_freq = categorize_ratio(get_normal_republish_frequency(client->client_id), &max_republish_freq);
    }

    int payload_len = length - index;
    features.payload_size = categorize_ratio(payload_len, &max_payload_size);

    return features;
}

// --- Extract SUBSCRIBE features ---
struct subscribe_features get_subscribe_features(uint8_t *buffer, size_t length, struct mqtt_client_info *client) {
    struct subscribe_features features = {0};

    if (length < 8 || !client) {
        return features; // Invalid packet or client missing
    }

    features.event_type = 3;
    features.clean_session = client->clean_session;

    uint8_t subscriber_index = get_subscriber_index(client->client_id);
    features.pending_queue_status = categorize_ratio(get_pending_queue_status(client->client_id), &max_pending_queue);
    features.subscription_count = categorize_ratio(get_subscription_count(subscriber_index), &max_subscription_queue);
    features.wildcard_subscription_count = categorize_ratio(get_wildcard_subscription_count(subscriber_index), &max_subscription_queue);
    features.resubscription_freq = categorize_ratio(get_resubscription_frequency(subscriber_index), &max_resubscription_freq);

    int index = 4; // Start after fixed header and packet ID
    bool wildcard_found = false;
    uint8_t max_qos = 0;

    while (index < length) {
        if (index + 3 > length) {
            break;
        }

        // Read topic length (2 bytes)
        uint16_t topic_length = (buffer[index] << 8) | buffer[index + 1];
        index += 2;

        if (topic_length == 0 || index + topic_length + 1 > length) {
            break;  // Invalid topic length
        }

        char topic[MAX_TOPIC_LEN] = {0};
        memcpy(topic, &buffer[index], topic_length);
        topic[topic_length] = '\0';
        index += topic_length;

        // Categorize retained queue status
        features.retained_queue_status = categorize_ratio(get_retained_queue_status(topic), &max_retained_queue);

        // Read QoS (1 byte)
        uint8_t req_qos = buffer[index++];
        if (req_qos > max_qos) {
            max_qos = req_qos;  // Store highest QoS requested
        }

        if (check_topic_wildcard(topic)) {
            wildcard_found = true;
        }
    }

    features.qos = max_qos;
    features.topic_contain_wildcard = wildcard_found;
    return features;
}
```

## src/features.h
```c
#define MAX_RECONNECT_FREQ 10 // per 10 seconds
#define MAX_RESUBSCRIPTION_FREQ 10 // per 10 seconds
#define MAX_REPUBLISH_FREQ 10 // per 10 secs
#define LOW_RATIO  0.3f  
#define HIGH_RATIO 0.7f  

struct connect_features {
    uint8_t event_type;              // Always 1
    uint8_t will_qos;                     // Extracted from Will QoS
    bool will_retain;                  // Will Retain flag
    uint8_t will_payload_size;            // Will message size
    bool will_flag;               // Will message exists
    bool will_topic_contain_wildcard; // Will topic name contain wildcard (#,+)
    uint8_t keep_alive;              // Keep-alive interval
    uint8_t reconn_freq;               // Connection/reconnect frequency per second    
    bool clean_session;           // Clean Session flag
    uint8_t pending_queue_status;           // Pending messages count
    uint8_t retained_queue_status;          // Retained messages count
    uint8_t subscription_count;          
};

struct publish_features {
    uint8_t event_type;              // Always 2
    uint8_t qos;                     // Extracted from QoS
    bool retain;                  // Will Retain flag
    bool clean_session;           // Clean Session flag
    uint8_t payload_size;            // Will message size
    bool topic_contain_wildcard; // Will topic name contain wildcard (#,+)
    uint8_t pending_queue_status;           // Pending messages count
    uint8_t retained_queue_status;          // Retained messages count
    uint8_t republish_freq;          // 

};

struct subscribe_features {
    uint8_t event_type;              // Always 3
    uint8_t qos;                     // Extracted from QoS
    bool clean_session;           // Clean Session flag
    bool topic_contain_wildcard; // topic name contain wildcard (#,+)
    uint8_t pending_queue_status;           // Pending messages count
    uint8_t retained_queue_status;          // Retained messages count
    uint8_t resubscription_freq;          //
    uint8_t subscription_count;          //
    uint8_t wildcard_subscription_count;
};



bool check_topic_wildcard(const char *topic);
struct subscribe_features get_subscribe_features(uint8_t *buffer, size_t length, struct mqtt_client_info *client);
struct publish_features get_publish_features(uint8_t *buffer, size_t length, struct mqtt_client_info *client);
struct connect_features get_connect_features(uint8_t *buffer, size_t length, uint8_t client_index, uint8_t client_id);
```

## src/message.h
```c
#ifndef MESSAGE_H
#define MESSAGE_H

#include <zephyr/net/net_context.h>


#define MAX_PACKET_SIZE 256
#define MAX_TOPIC_LEN 100
#define MAX_MESSAGE_LEN 500
#define MAX_PENDING_MESSAGES 20
#define MAX_RETAINED_MESSAGES 20  // Adjust based on memory limits
#define QOS_TIMEOUT 5000 // 5 seconds

#ifndef MAX_CLIENT_ID_LEN  // 23 bytes
#define MAX_CLIENT_ID_LEN 23
#endif // MAX_CLIENT_ID_LEN


typedef enum {
    LOW,
    MEDIUM,
    HIGH
} queue_status_t;

// Struct to store retained messages
struct mqtt_retained_msg {
    char topic[MAX_TOPIC_LEN];
    uint8_t payload[MAX_MESSAGE_LEN];
    size_t payload_len;
    uint8_t qos;
    bool valid;
    char client_id[MAX_CLIENT_ID_LEN];  
};

typedef enum {
    PENDING_PUBACK,  // QoS 1: Waiting for PUBACK
    PENDING_PUBREC,  // QoS 2: Waiting for PUBREC
    PENDING_PUBREL,  // QoS 2: Waiting for PUBREL
    PENDING_PUBCOMP, // QoS 2: Waiting for PUBCOMP
    NONE_PENDING     // No pending message
} mqtt_qos_state_t;

struct mqtt_pending_msg {
    uint16_t packet_id;
    char topic[MAX_TOPIC_LEN];
    uint8_t payload[MAX_MESSAGE_LEN];
    size_t payload_len;
    uint8_t qos;
    bool dup;  // For retransmission flag
    bool valid;
    mqtt_qos_state_t state;  // New field to track QoS state
    uint32_t timestamp;  // For timeout handling
    char client_id[MAX_CLIENT_ID_LEN];  
};


extern struct mqtt_retained_msg retained_messages[MAX_RETAINED_MESSAGES];
extern struct mqtt_pending_msg pending_messages[MAX_PENDING_MESSAGES];


uint16_t generate_packet_id(void);
void store_will_message(const char *client_id, const char *topic, const char *message, uint8_t qos, bool retain);
void store_retained_message(const char *client_id, const char *topic, const uint8_t *payload, size_t len, uint8_t qos);
void store_pending_message(const char *client_id, uint16_t packet_id, const char *topic, const uint8_t *payload, size_t payload_len, uint8_t qos);
void restore_pending_messages(struct net_context *ctx, const char *client_id);
void clear_retained_message(const char *client_id, const char *topic);
void clear_pending_message(uint16_t packet_id);
void clear_pending_messages(const char *client_id);
void clear_will_message(const char *client_id);
void deliver_message(const char *topic, const uint8_t *payload, uint8_t pub_qos, bool dup);
void deliver_pending_message(const char *client_id, struct net_context *ctx,  uint16_t packet_id, uint8_t qos, const char *topic, const uint8_t *payload, bool dup);
void deliver_retained_message(const char *client_id, struct net_context *ctx, const char *topic);
void delivery_will_message(const char *client_id, const char *topic, const uint8_t *payload, size_t payload_len, uint8_t qos, bool retain);
uint8_t get_retained_queue_status(const char *topic);
uint8_t get_pending_queue_status(const char *client_id);

#endif // MESSAGE_HANDLER_H
```

## src/publish.h
```c
#include <zephyr/net/net_ip.h>
#include <zephyr/net/net_context.h>
#include "client.h"


struct publisher_stats {
    char client_id[MAX_CLIENT_ID_LEN];  // Store Client ID
    uint8_t wildcard_republish_count;  // Wildcard topic message count
    uint8_t normal_republish_count;
    uint64_t last_reset_time;  // Last time reset
    bool valid;  // Flag to mark if the publisher is active
    uint8_t index;  // Position in the array
};

struct publisher_manager {
    struct publisher_stats publishers[MAX_CLIENTS];  // List of publishers
    uint8_t publisher_count;  // Total registered publishers
};


int find_publisher_index(const char *client_id);
int add_publisher(const char *client_id);
void remove_publisher(const char *client_id);
uint8_t get_normal_republish_frequency(const char *client_id);
uint8_t get_wildcard_republish_frequency(const char *client_id);
void track_republish_frequency(const char *client_id, bool is_wildcard);
size_t encode_remaining_length(uint8_t *buf, size_t length);
size_t decode_remaining_length(uint8_t *buffer, size_t *remaining_length);
size_t construct_publish_packet(uint8_t *buffer, const char *topic, const uint8_t *payload, 
					size_t payload_len, uint8_t qos, bool dup, bool retain, uint16_t packet_id);
void send_puback(struct net_context *ctx, uint16_t packet_id);
void send_pubcomp(struct net_context *ctx, uint16_t packet_id);
void send_pubrec(struct net_context *ctx, uint16_t packet_id);
void handle_publish(struct net_context *ctx, uint8_t *buffer, size_t length);
void handle_pubrel(struct net_context *ctx, uint8_t *buffer, size_t length);
```
